## drivers/linux/rdma/drv/ionic/Kconfig
```kconfig
# SPDX-License-Identifier: GPL-2.0 OR Linux-OpenIB
# Copyright (C) 2020-2024, Advanced Micro Devices, Inc.

config INFINIBAND_IONIC
	tristate "AMD Pensando DSC RDMA/RoCE Support"
	depends on NETDEVICES && ETHERNET && PCI && INET && 64BIT
	select NET_VENDOR_PENSANDO
	select IONIC
	help
	  This enables RDMA/RoCE support for the AMD Pensando family of
	  Distributed Services Cards (DSCs).

	  To learn more, visit <https://www.amd.com/en/accelerators/pensando>.

	  To compile this driver as a module, choose M here. The module
	  will be called ionic_rdma.
```
